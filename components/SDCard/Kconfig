## components/SDCard/Kconfig
```kconfig
menu "SDCard Configuration"

  config MAX_READ_CHAR_SIZE
      int "The maximum number of bytes to read into a line"
      default 64
      help
        Enter the maximum number of bytes to read into a line

  config FORMAT_IF_MOUNT_FAILED
      bool "Format the card if mount failed"
      default n
      help
          If this config item is set, format_if_mount_failed will be set to true and the card will be formatted if
          the mount has failed.

  config FORMAT_SD_CARD
      bool "Format the card as a part of the example"
      default n
      help
          If this config item is set, the card will be formatted as a part of the example.

  config PIN_MOSI
      int "MOSI GPIO number"
      default 15 if IDF_TARGET_ESP32
      default 35 if IDF_TARGET_ESP32S2
      default 4 if IDF_TARGET_ESP32S3
      default 5  if IDF_TARGET_ESP32H2
      default 36 if IDF_TARGET_ESP32P4
      default 4  # C3 and others

  config PIN_MISO
      int "MISO GPIO number"
      default 2 if IDF_TARGET_ESP32
      default 37 if IDF_TARGET_ESP32S2
      default 5 if IDF_TARGET_ESP32S3
      default 0  if IDF_TARGET_ESP32H2
      default 47 if IDF_TARGET_ESP32P4
      default 6  # C3 and others

  config PIN_CLK
      int "CLK GPIO number"
      default 14 if IDF_TARGET_ESP32
      default 36 if IDF_TARGET_ESP32S2
      default 2 if IDF_TARGET_ESP32S3
      default 4  if IDF_TARGET_ESP32H2
      default 53 if IDF_TARGET_ESP32P4
      default 5  # C3 and others

  config PIN_CS
      int "CS GPIO number"
      default 13 if IDF_TARGET_ESP32
      default 34 if IDF_TARGET_ESP32S2
      default 8 if IDF_TARGET_ESP32S3
      default 33 if IDF_TARGET_ESP32P4
      default 1  # C3 and others

  config DEBUG_PIN_CONNECTIONS
      bool "Debug sd pin connections and pullup strength"
      default n

  config ENABLE_ADC_FEATURE
      bool "Enable ADC feature"
      depends on DEBUG_PIN_CONNECTIONS
      default y if IDF_TARGET_ESP32
      default n

  config ADC_UNIT
      int "ADC Unit"
      depends on DEBUG_PIN_CONNECTIONS
      default 1 if IDF_TARGET_ESP32
      default 0 if IDF_TARGET_ESP32S3
      default 1

  config ADC_PIN_MOSI
      int "MOSI mapped ADC pin"
      depends on ENABLE_ADC_FEATURE
      default 3 if IDF_TARGET_ESP32
      default 7 if IDF_TARGET_ESP32S3
      default 1

  config ADC_PIN_MISO
      int "MISO mapped ADC pin"
      depends on ENABLE_ADC_FEATURE
      default 2 if IDF_TARGET_ESP32
      default 1 if IDF_TARGET_ESP32S3
      default 1

  config ADC_PIN_CLK
      int "CLK mapped ADC pin"
      depends on ENABLE_ADC_FEATURE
      default 6 if IDF_TARGET_ESP32
      default 0 if IDF_TARGET_ESP32S3
      default 1

  config ADC_PIN_CS
      int "CS mapped ADC pin"
      depends on ENABLE_ADC_FEATURE
      default 4 if IDF_TARGET_ESP32
      default 6 if IDF_TARGET_ESP32S3
      default 1

  config SD_PWR_CTRL_LDO_INTERNAL_IO
      depends on SOC_SDMMC_IO_POWER_EXTERNAL
      bool "SD power supply comes from internal LDO IO (READ HELP!)"
      default n
      help
          Only needed when the SD card is connected to specific IO pins which can be used for high-speed SDMMC.
          Please read the schematic first and check if the SD VDD is connected to any internal LDO output.
          Unselect this option if the SD card is powered by an external power supply.

  config SD_PWR_CTRL_LDO_IO_ID
      depends on SOC_SDMMC_IO_POWER_EXTERNAL && SD_PWR_CTRL_LDO_INTERNAL_IO
      int "LDO ID"
      default 4 if IDF_TARGET_ESP32P4
      help
          Please read the schematic first and input your LDO ID.



    choice SDMMC_BUS_WIDTH
        prompt "SD/MMC bus width"
        default SDMMC_BUS_WIDTH_4
        help
            Select the bus width of SD or MMC interface.
            Note that even if 1 line mode is used, D3 pin of the SD card must have a pull-up resistor connected.
            Otherwise the card may enter SPI mode, the only way to recover from which is to cycle power to the card.

        config SDMMC_BUS_WIDTH_4
            bool "4 lines (D0 - D3)"

        config SDMMC_BUS_WIDTH_1
            bool "1 line (D0)"
    endchoice

    choice SDMMC_SPEED_MODE
        prompt "SD/MMC speed mode"
        default SDMMC_SPEED_DS

        config SDMMC_SPEED_DS
            bool "Default Speed"
        config SDMMC_SPEED_HS
            bool "High Speed"
        config SDMMC_SPEED_UHS_I_SDR50
            bool "UHS-I SDR50 (100 MHz, 50 MB/s)"
            depends on SOC_SDMMC_UHS_I_SUPPORTED
        config SDMMC_SPEED_UHS_I_DDR50
            bool "UHS-I DDR50 (50 MHz, 50 MB/s)"
            depends on SOC_SDMMC_UHS_I_SUPPORTED
        config SDMMC_SPEED_UHS_I_SDR104
            bool "UHS-I SDR104 (200 MHz, 100 MB/s)"
            depends on SOC_SDMMC_UHS_I_SUPPORTED
    endchoice

    config PIN_CARD_POWER_RESET
        int
        depends on SOC_SDMMC_IO_POWER_EXTERNAL
        prompt "Card Power Reset"
        default 45

    config PIN_CMD
        int
        prompt "CMD GPIO number" if SOC_SDMMC_USE_GPIO_MATRIX
        default 35 if IDF_TARGET_ESP32S3
        default 44 if IDF_TARGET_ESP32P4
        default 15 if IDF_TARGET_ESP32

    config MMC_PIN_CLK
        int
        prompt "CLK GPIO number" if SOC_SDMMC_USE_GPIO_MATRIX
        default 36 if IDF_TARGET_ESP32S3
        default 43 if IDF_TARGET_ESP32P4
        default 14 if IDF_TARGET_ESP32

    config PIN_D0
        int
        prompt "D0 GPIO number" if SOC_SDMMC_USE_GPIO_MATRIX
        default 37 if IDF_TARGET_ESP32S3
        default 39 if IDF_TARGET_ESP32P4
        default 2 if IDF_TARGET_ESP32

    if SDMMC_BUS_WIDTH_4

        config PIN_D1
            int
            prompt "D1 GPIO number" if SOC_SDMMC_USE_GPIO_MATRIX
            default 38 if IDF_TARGET_ESP32S3
            default 40 if IDF_TARGET_ESP32P4
            default 4 if IDF_TARGET_ESP32


        config PIN_D2
            int
            prompt "D2 GPIO number" if SOC_SDMMC_USE_GPIO_MATRIX
            default 33 if IDF_TARGET_ESP32S3
            default 41 if IDF_TARGET_ESP32P4
            default 12 if IDF_TARGET_ESP32


        config PIN_D3
            int
            prompt "D3 GPIO number" if SOC_SDMMC_USE_GPIO_MATRIX
            default 34 if IDF_TARGET_ESP32S3
            default 42 if IDF_TARGET_ESP32P4
            default 13 if IDF_TARGET_ESP32

    endif  # SDMMC_BUS_WIDTH_4

    if SDMMC_BUS_WIDTH_4

        config ADC_PIN_D1
            int "D1 mapped ADC pin"
            depends on ENABLE_ADC_FEATURE
            default 0 if IDF_TARGET_ESP32
            default 1

        config ADC_PIN_D2
            int "D2 mapped ADC pin"
            depends on ENABLE_ADC_FEATURE
            default 5 if IDF_TARGET_ESP32
            default 1

        config ADC_PIN_D3
            int "D3 mapped ADC pin"
            depends on ENABLE_ADC_FEATURE
            default 4 if IDF_TARGET_ESP32
            default 1

    endif  # SDMMC_BUS_WIDTH_4

endmenu
```
